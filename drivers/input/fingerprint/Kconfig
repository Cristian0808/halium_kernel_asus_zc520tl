## drivers/input/fingerprint/Kconfig
```kconfig
#
#Fingerprint
#

config MTK_FINGERPRINT
	tristate "Mediatek Fingerprint"
	default n
	---help---
	Fingerprint mtk driver enable/disable in the kernel.
	Say Y here if you want to use mediatek fingerprint driver,
	fingerprint driver will support fingerprint function in REE,
	it supports FPC's 102x/104x device.
##zhaozhensen 20160513 begin
if MTK_FINGERPRINT

config GOODIX_FINGERPRINT
	tristate "Goodix Fingerprint"
	default n
	---help---
	Goodix Fingerprint chip GF316M/GF318M/GF3118M/GF518M/GF5118M/GF516M/GF816M/GF3208/GF5216 TEE driver

config GOODIX_SENSOR_TYPE
	string "SENSOR_TYPE"
	default "GF318M"
	---help---
	Must input sensor type, or default is GF316M GF318M GF3118M GF518M GF5118M GF516M GF816M GF3208 GF5216

endif
##zhaozhensen 20160513 end
```

## drivers/misc/mediatek/fingerprint/Kconfig
```kconfig
#ranyanhao 20160216 begin
config MTK_GF318_SUPPORT
	bool "CONFIG_MTK_GF318_SUPPORT"
	default n
	help
		Select y or n
#ranyanhao 20160216 end

#zhenglihong 20160430 begin
config MTK_AFS121_SUPPORT
	bool "CONFIG_MTK_AFS121_SUPPORT"
	default n
	help
		Select y or n
#zhenglihong 20160430 end

#liukangping@wind-mobi 20160421 begin
config MTK_SILEAD6163
        bool "CONFIG_MTK_SILEAD6163"
        default n
	help
        It support different fingerprint sensor.
        If this option is set,
	  	it will support fingerprint driver.	
		
#liukangping@wind-mobi 20162416 end



     
```

## drivers/misc/mediatek/magnetometer/mmc3524x/Kconfig
```kconfig
#ranyanhao 20160118 begin
config MTK_MMC3524X
	bool "CONFIG_MTK_MMC3524X"
	default n
	help
		Select mmc3524x driver y or n
#ranyanhao 20160118 end
```

## drivers/misc/mediatek/power/Kconfig
```kconfig
# Power Related
config MTK_PMIC
	bool "MediaTek PMIC driver"
	default y
	---help---
	  MediaTek PMIC driver

config MTK_BQ25896_SUPPORT
	bool "MTK_BQ25896_SUPPORT"
	select MTK_SWITCH_INPUT_OUTPUT_CURRENT_SUPPORT
	default n
	---help---
	Mediatek TI BQ25896 driver.
	Set y to support this driver.
	Set n and choose other chargers.
	This driver uses I2c bus.
	
#ranyanhao 20160120 begin
config MTK_FAN5405_SUPPORT
	bool "MTK_FAN5405_SUPPORT"
	select MTK_SWITCH_INPUT_OUTPUT_CURRENT_SUPPORT
	default n
	---help---
	Mediatek TI FAN5405 driver.
	Set y to support this driver.
	Set n and choose other chargers.
	This driver uses I2c bus.
#ranyanhao 20160120 end

#zhenglihon 20160506 begin
config MTK_NCP1854_SUPPORT
	bool "MTK_NCP1854_SUPPORT"
	select MTK_SWITCH_INPUT_OUTPUT_CURRENT_SUPPORT
	default n
	---help---
	Mediatek TI NCP1854 driver.
	Set y to support this driver.
	Set n and choose other chargers.
	This driver uses I2c bus.
#zhenglihong 20160506 end
config MTK_SWITCH_INPUT_OUTPUT_CURRENT_SUPPORT
	bool "MTK_SWITCH_INPUT_OUTPUT_CURRENT_SUPPORT"
	default n
	---help---
	Mediatek switch charger input output current.
	Set y to support.
	Set n to disable.
	switch charger often supports this feature.

config MTK_BIF_SUPPORT
	bool "MTK_BIF_SUPPORT"
	select MTK_DYNAMIC_BAT_CV_SUPPORT
	default n
	---help---
	Mediatek smart battery BIF feature.
	BIF feature provides battery information
	to AP and no need to use AuxADC
	to get battery information.

config MTK_DYNAMIC_BAT_CV_SUPPORT
	bool "MTK_DYNAMIC_BAT_CV_SUPPORT"
	default n
	---help---
	Mediatek dynamic CV support with BIF battery
	BIF feature provides battery information
	to AP and no need to use AuxADC
	to get battery voltage.
```

## drivers/misc/mediatek/usbsw/Kconfig
```kconfig
#yutao 20160601 begin
config MTK_USBSW
  bool "CONFIG_MTK_USBSW"
  default n
  help
    CONFIG_MTK_USBSW
#yutao 20160601 end
```
