/*************************
 * Customized Battery Setting dtsi file
*************************/
&bat_comm {
/* ranyanhao 20160305 begin */
	/* cust_charging.h */
	/* stop charging while in talking mode */
	stop_charging_in_takling = <1 >;
	talking_recharge_voltage = <3800 >;
	talking_sync_time = <60 >;

	/* Battery Temperature Protection */
	mtk_temperature_recharge_support = <1 >;
	max_charge_temperature = <55 >;
	max_charge_temperature_minus_x_degree = <51 >;
	min_charge_temperature = <0 >;
	min_charge_temperature_plus_x_degree = <5 >;
	err_charge_temperature = <0xff >;

	/* Linear Charging Threshold */
	v_pre2cc_thres = <3400 >;	/* unit: mV */
	v_cc2topoff_thres = <4200 >;
	recharging_voltage = <4260 >;
	charging_full_current = <190 >;	/* unit: mA */    /* ranyanhao < 0.05CC */

	/* Charging Current Setting */
	config_usb_if = <0 >;
	usb_charger_current_suspend = <0 >;	/* Unit: 0.01 mA */
	usb_charger_current_unconfigured = <7000 >;	/* Unit: 0.01 mA */
	usb_charger_current_configured = <50000 >;	/* Unit: 0.01 mA */
	usb_charger_current = <50000 >;	/* Unit: 0.01 mA */
	ac_charger_input_current = <200000 >; /* Unit: 0.01 mA */
	ac_charger_current = <170000 >;	/* Unit: 0.01 mA */
	non_std_ac_charger_current = <50000 >;	/* Unit: 0.01 mA */
	charging_host_charger_current = <65000 >;	/* Unit: 0.01 mA */
	apple_0_5a_charger_current = <50000 >;	/* Unit: 0.01 mA */
	apple_1_0a_charger_current = <65000 >;	/* Unit: 0.01 mA */
	apple_2_1a_charger_current = <80000 >;	/* Unit: 0.01 mA */

	/* charger error check */
	bat_low_temp_protect_enable = <1 >;
	v_charger_enable = <1 >;	/* 1:on , 0:off */  
	v_charger_max = <6500 >;	/* unit: mV */
	v_charger_min = <4400 >;

	/*  Tracking TIME */
	onehundred_percent_tracking_time = <10 >;	/* Unit: second */
	npercent_tracking_time = <20 >;	/* Unit: second */
	sync_to_real_tracking_time = <60 >;	/* Unit: second */
	v_0percent_tracking = <3450 >;	/* Unit: mV */

	/* High battery support */
	high_battery_voltage_support = <1 >;
	ASUS_4_4V_battery_voltage_support = <1 >;
/* ranyanhao 20160305 end */
};

&bat_meter {
/* ranyanhao 20160305 begin */
	/* cust_battery_meter.h */
	/* ADC resistor  */
	r_bat_sense = <4 >;
	r_i_sense = <4 >;
	r_charger_1 = <330 >;
	r_charger_2 = <39 >;
	temperature_t0 = <110 >;
	temperature_t1 = <0 >;
	temperature_t2 = <25 >;
	temperature_t3 = <50 >;
	temperature_t = <255 >;	/* this should be fixed, never change the value */
	fg_meter_resistance = <0 >;

	/* Qmax for 0mA */
	q_max_pos_50 = <3933 >;
	q_max_pos_25 = <3811 >;
	q_max_pos_0 = <3594 >;
	q_max_neg_10 = <3351 >;
	/* Qmax for 400mA, said high current */
	q_max_pos_50_h_current = <3880 >;
	q_max_pos_25_h_current = <3785 >;
	q_max_pos_0_h_current = <3452 >;
	q_max_neg_10_h_current = <1892 >;

	/* Discharge percentage, 1: D5, 0: D2 */
	oam_d5 = <1 >;

	change_tracking_point = <1 >;
	/* SW OCV tracking setting */
	cust_tracking_point = <1 >;
	cust_r_sense = <33 >;
	cust_hw_cc = <0 >;
	aging_tuning_value = <103 >;
	cust_r_fg_offset = <0 >;
	ocv_board_compesate = <0 >;
	r_fg_board_base = <1000 >;
	r_fg_board_slope = <1000 >;
	car_tune_value = <76 >; /* need the new confirmation */

	/* HW Fuel gague  */
	current_detect_r_fg = <10 >;	/* Unit: mA */
	minerroroffset = <1000 >;
	fg_vbat_average_size = <18 >;
	r_fg_value = <10 >;	/* Unit: mOhm */

	cust_poweron_delta_capacity_tolrance = <40 >;
	cust_poweron_low_capacity_tolrance = <5 >;
	cust_poweron_max_vbat_tolrance = <90 >;
	cust_poweron_delta_vbat_tolrance = <30 >;
	cust_poweron_delta_hw_sw_ocv_capacity_tolrance = <10 >;

	/* Fixed battery temperature */
	fixed_tbat_25 = <0 >;
	
	/* Battery remove detecton */
	vbat_remove_detection = <0>;
	
	/* Dynamic change wake up period of battery thread when suspend */
	vbat_normal_wakeup = <3600 >;	/* Unit: mV */
	vbat_low_power_wakeup = <3500 >;	/* Unit: mV */
	normal_wakeup_period = <5400 >;	/* Unit: second */
	low_power_wakeup_period = <300 >;	/* Unit: second */
	close_poweroff_wakeup_period = <30 >;	/* Unit: second */

	rbat_pull_up_r = <61900 >;
	rbat_pull_up_volt = <1800 >;


	batt_temperature_table_num = <17 >;
	batt_temperature_table = <
		(-20) 388154
		(-15) 360850
		(-10) 271697
		(-5) 206463
		0 158214
		5 122259
		10 95227 
		15 74730 
		20 59065 
		25 47000 
		30 37643 
		35 30334 
		40 24591 
		45 20048 
		50 16433 
		55 13539 
		60 11210  >;
		battery_profile_t0_num = <86 >;
battery_profile_t0 = <
0    4392
1    4372
3    4351
4    4333
6    4314
7    4296
9    4278
10   4261
12   4241
13   4218
15   4189
16   4159
18   4131
19   4113
21   4099
22   4086
24   4072
25   4055
27   4036
28   4017
30   3999
31   3984
33   3970
34   3957
36   3944
37   3933
39   3921
40   3910
42   3899
43   3889
45   3880
46   3871
48   3863
49   3856
51   3849
52   3842
54   3836
55   3830
57   3824
58   3819
60   3814
61   3810
63   3806
64   3802
66   3799
67   3795
69   3792
70   3789
72   3785
73   3781
75   3777
76   3773
78   3768
79   3763
81   3757
82   3751
84   3745
85   3737
86   3729
87   3722
88   3717
89   3713
90   3710
91   3705
92   3701
93   3699
94   3697
95   3694
96   3690
97   3684
98   3677
99   3660
100  3400
100  3400
100  3400
100  3400
100  3400
100  3400
100  3400
100  3400
100  3400
100  3400
100  3400
100  3400
100  3400
100  3400>;
battery_profile_t1_num = <86 >;
battery_profile_t1 = <			
0 	 4393 
1    4376 
3    4355 
4    4338 
6    4322 
7    4307 
8    4292 
10   4277 
11   4263 
13   4249 
14   4235 
15   4220 
17   4206 
18   4192 
19   4178 
21   4165 
22   4151 
24   4138 
25   4124 
26   4110 
28   4096 
29   4084 
31   4071 
32   4058 
33   4040 
35   4019 
36   3997 
38   3977 
39   3960 
40   3947 
42   3936 
43   3928 
45   3919 
46   3911 
47   3903 
49   3895 
50   3887 
51   3879 
53   3872 
54   3864 
56   3858 
57   3851 
58   3844 
60   3838 
61   3832 
63   3826 
64   3820 
65   3814 
67   3809 
68   3803 
70   3798 
71   3792 
72   3787 
74   3782 
75   3776 
77   3771 
78   3766 
79   3760 
81   3753 
82   3747 
83   3739 
85   3731 
86   3723 
88   3713 
89   3707 
90   3703 
92   3700 
93   3698 
95   3694 
96   3685 
97   3654 
99   3595 
100  3400 
100  3400 
100  3400 
100  3400 
100  3400 
100  3400 
100  3400 
100  3400 
100  3400 
100  3400 
100  3400 
100  3400 
100  3400 
100  3400 >;
battery_profile_t2_num = <86 >;
battery_profile_t2 = <
0    4365
1    4364
2    4349
4    4334
5    4320
6    4305
7    4291
9    4276
10   4262
11   4247
12   4234
13   4220
15   4205
16   4190
17   4178
18   4164
20   4149
21   4134
22   4122
23   4108
24   4095
26   4082
27   4069
28   4060
29   4047
30   4035
32   4023
33   4010
34   3999
35   3988
37   3978
38   3970
39   3961
40   3951
41   3939
43   3927
44   3912
45   3896
46   3883
48   3873
49   3865
50   3858
51   3850
52   3844
54   3837
55   3833
56   3827
57   3822
59   3817
60   3813
61   3806
62   3803
63   3799
65   3796
66   3793
67   3790
68   3787
69   3784
71   3781
72   3777
73   3772
74   3766
76   3761
77   3757
78   3753
79   3747
80   3744
82   3740
83   3735
84   3727
85   3718
87   3712
88   3704
89   3694
90   3691
91   3689
93   3688
94   3686
95   3682
96   3654
98   3598
99   3517
100  3400
100  3400
100  3400
100  3400>;
	battery_profile_t3_num = <86 >;
	battery_profile_t3 = <
0   4393 
1   4390 
2   4368 
4   4351 
5   4335 
6   4320 
7   4306 
8   4292 
9   4277 
11  4263 
12  4249 
13  4235 
14  4221 
15  4207 
17  4193 
18  4179 
19  4165 
20  4152 
21  4138 
22  4125 
24  4112 
25  4099 
26  4085 
27  4074 
28  4061 
30  4049 
31  4038 
32  4026 
33  4014 
34  4003 
35  3993 
37  3983 
38  3973 
39  3963 
40  3954 
41  3944 
43  3935 
44  3925 
45  3913 
46  3898 
47  3882 
48  3871 
50  3861 
51  3854 
52  3847 
53  3841 
54  3835 
56  3828 
57  3823 
58  3818 
59  3813 
60  3809 
61  3804 
63  3800 
64  3796 
65  3792 
66  3789 
67  3786 
69  3783 
70  3779 
71  3776 
72  3772 
73  3766 
74  3756 
76  3750 
77  3746 
78  3742 
79  3737 
80  3732 
82  3728 
83  3724 
84  3719 
85  3712 
86  3703 
88  3696 
89  3687 
90  3678 
91  3677 
92  3676 
93  3675 
95  3673 
96  3667 
97  3638 
98  3583 
99  3506 
100 3400 >;
	r_profile_t0_num = <86 >;
	r_profile_t0 = <
878   4392 
878   4372 
901   4351 
912   4333 
917   4314 
922   4296 
925   4278 
935   4261 
952   4241 
989   4218 
1032  4189 
1085  4159 
1103  4131 
1103  4113 
1105  4099 
1110  4086 
1112  4072 
1110  4055 
1100  4036 
1092  4017 
1085  3999 
1083  3984 
1084  3970 
1080  3957 
1076  3944 
1072  3933 
1066  3921 
1062  3910 
1064  3899 
1055  3889 
1054  3880 
1049  3871 
1050  3863 
1052  3856 
1053  3849 
1054  3842 
1060  3836 
1062  3830 
1063  3824 
1067  3819 
1073  3814 
1083  3810 
1092  3806 
1099  3802 
1109  3799 
1120  3795 
1132  3792 
1144  3789 
1153  3785 
1167  3781 
1179  3777 
1195  3773 
1211  3768 
1229  3763 
1246  3757 
1267  3751 
1288  3745 
1311  3737 
1322  3729 
1304  3722 
1293  3717 
1283  3713 
1275  3710 
1262  3705 
1253  3701 
1247  3699 
1242  3697 
1235  3694 
1226  3690 
1209  3684 
1191  3677 
1149  3660 
1030  3612 
1030  3612 
1030  3612 
1030  3612 
1030  3612 
1030  3612 
1030  3612 
1030  3612 
1030  3612 
1030  3612 
1030  3612 
1030  3612 
1030  3612 
1030  3612 >;
	r_profile_t1_num = <86 >;
	r_profile_t1 = <
503   4393 	 
503   4376 	 
498   4355 	 
500   4338 	 
502   4322 	 
502   4307 	 
502   4292 	 
502   4277 	 
502   4263 	 
503   4249 	 
502   4235 	 
502   4220 	 
502   4206 	 
502   4192 	 
504   4178 	 
505   4165 	 
506   4151 	 
508   4138 	 
508   4124 	 
508   4110 	 
507   4096 	 
508   4084 	 
512   4071 	 
516   4058 	 
515   4040 	 
505   4019 	 
491   3997 	 
476   3977 	 
462   3960 	 
456   3947 	 
450   3936 	 
449   3928 	 
449   3919 	 
448   3911 	 
449   3903 	 
450   3895 	 
450   3887 	 
450   3879 	 
451   3872 	 
453   3864 	 
457   3858 	 
459   3851 	 
460   3844 	 
461   3838 	 
462   3832 	 
465   3826 	 
467   3820 	 
471   3814 	 
471   3809 	 
474   3803 	 
477   3798 	 
478   3792 	 
481   3787 	 
483   3782 	 
488   3776 	 
491   3771 	 
496   3766 	 
503   3760 	 
509   3753 	 
514   3747 	 
522   3739 	 
529   3731 	 
536   3723 	 
536   3713 	 
539   3707 	 
550   3703 	 
568   3700 	 
597   3698 	 
640   3694 	 
706   3685 	 
789   3654 	 
904   3595 	 
904   3398 	 
904   3398 	 
904   3398 	 
904   3398 	 
904   3398 	 
904   3398 	 
904   3398 	 
904   3398 	 
904   3398 	 
904   3398 	 
904   3398 	 
904   3398 	 
904   3398 	 
904   3398 	 >;

	r_profile_t2_num = <86 >;
	r_profile_t2 = <
115   4365 
115   4364 
118   4349 
118   4334 
117   4320 
118   4305 
119   4291 
117   4276 
119   4262 
116   4247 
121   4234 
120   4220 
116   4205 
115   4190 
120   4178 
122   4164 
122   4149 
116   4134 
120   4122 
119   4108 
120   4095 
120   4082 
118   4069 
125   4060 
125   4047 
126   4035 
130   4023 
129   4010 
136   3999 
140   3988 
143   3978 
142   3970 
146   3961 
148   3951 
147   3939 
145   3927 
133   3912 
122   3896 
115   3883 
113   3873 
117   3865 
117   3858 
112   3850 
116   3844 
112   3837 
115   3833 
113   3827 
114   3822 
114   3817 
117   3813 
112   3806 
115   3803 
116   3799 
123   3796 
125   3793 
124   3790 
126   3787 
129   3784 
133   3781 
130   3777 
126   3772 
123   3766 
123   3761 
122   3757 
122   3753 
123   3747 
124   3744 
123   3740 
124   3735 
125   3727 
124   3718 
125   3712 
126   3704 
124   3694 
126   3691 
127   3689 
135   3688 
137   3686 
148   3682 
140   3654 
149   3598 
158   3517 
186   3396 
186   3396 
186   3396 
186   3396 >;

	r_profile_t3_num = <86 >;
	r_profile_t3 = <
162   4393 
162   4390 
152   4368 
147   4351 
143   4335 
143   4320 
143   4306 
143   4292 
143   4277 
143   4263 
143   4249 
143   4235 
143   4221 
143   4207 
143   4193 
144   4179 
143   4165 
143   4152 
144   4138 
144   4125 
143   4112 
144   4099 
143   4085 
143   4074 
142   4061 
144   4049 
145   4038 
146   4026 
147   4014 
144   4003 
147   3993 
147   3983 
149   3973 
152   3963 
154   3954 
157   3944 
161   3935 
164   3925 
163   3913 
150   3898 
139   3882 
131   3871 
126   3861 
126   3854 
123   3847 
123   3841 
123   3835 
121   3828 
122   3823 
122   3818 
120   3813 
121   3809 
122   3804 
122   3800 
122   3796 
122   3792 
123   3789 
124   3786 
125   3783 
126   3779 
127   3776 
130   3772 
130   3766 
123   3756 
120   3750 
121   3746 
122   3742 
121   3737 
120   3732 
122   3728 
125   3724 
129   3719 
130   3712 
128   3703 
134   3696 
129   3687 
112   3678 
114   3677 
119   3676 
128   3675 
144   3673 
190   3667 
259   3638 
322   3583 
442   3506 
474   3389 >;
			
/* lvwenkang 20160510 end */
};
